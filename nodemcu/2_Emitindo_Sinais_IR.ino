#include <IRremoteESP8266.h> //INCLUSÃO DE BIBLIOTECA

IRsend irsend(14); //FUNÇÃO RESPONSÁVEL PELO MÉTODO DE ENVIO DO SINAL IR / UTILIZA O GPIO14(D5)

int tamanho = 68; //TAMANHO DA LINHA RAW(68 BLOCOS)
int frequencia = 32; //FREQUÊNCIA DO SINAL IR(32KHz)

// BOTÃO LIGA / DESLIGA
unsigned int LD[68] = {9050,4500,600,600,600,600,600,600,600,600,600,600,600,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1700,550}; //COLE A LINHA RAW CORRESPONDENTE DENTRO DAS CHAVES
// BOTÃO MUTE
unsigned int MT[68] = {9050,4500,600,600,600,600,600,600,600,600,550,600,600,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1700,600}; //COLE A LINHA RAW CORRESPONDENTE DENTRO DAS CHAVES
/*
// BOTÃO PLAY / PAUSE
unsigned int PP[68] = {}; //COLE A LINHA RAW CORRESPONDENTE DENTRO DAS CHAVES
// BOTÃO VOLTAR
unsigned int VT[68] = {}; //COLE A LINHA RAW CORRESPONDENTE DENTRO DAS CHAVES
// BOTÃO ADIANTAR
unsigned int AT[68] = {}; //COLE A LINHA RAW CORRESPONDENTE DENTRO DAS CHAVES
*/
// BOTÃO UM
unsigned int UM[68] = {9050,4500,600,600,600,600,600,600,600,600,600,600,600,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1700,600}; //COLE A LINHA RAW CORRESPONDENTE DENTRO DAS CHAVES
// BOTÃO DOIS
unsigned int DOIS[68] = {9050,4500,600,550,600,550,650,550,600,550,650,500,600,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1700,550}; //COLE A LINHA RAW CORRESPONDENTE DENTRO DAS CHAVES
// BOTÃO TRES
unsigned int TRES[68] = {9050,4500,600,600,600,600,650,550,600,600,600,600,600,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1700,600}; //COLE A LINHA RAW CORRESPONDENTE DENTRO DAS CHAVES
/*
// BOTÃO QUATRO
unsigned int QUATRO[68] = {}; //COLE A LINHA RAW CORRESPONDENTE DENTRO DAS CHAVES
// BOTÃO CINCO
unsigned int CINCO[68] = {}; //COLE A LINHA RAW CORRESPONDENTE DENTRO DAS CHAVES
// BOTÃO SEIS
unsigned int SEIS[68] = {}; //COLE A LINHA RAW CORRESPONDENTE DENTRO DAS CHAVES
// BOTÃO SETE
unsigned int SETE[68] = {}; //COLE A LINHA RAW CORRESPONDENTE DENTRO DAS CHAVES
// BOTÃO OITO
unsigned int OITO[68] = {}; //COLE A LINHA RAW CORRESPONDENTE DENTRO DAS CHAVES
// BOTÃO NOVE
unsigned int NOVE[68] = {}; //COLE A LINHA RAW CORRESPONDENTE DENTRO DAS CHAVES
// BOTÃO AUMENTAR VOLUME
unsigned int VMAIS[68] = {}; //COLE A LINHA RAW CORRESPONDENTE DENTRO DAS CHAVES
*/
// BOTÃO ZERO
unsigned int ZERO[68] = {9050,4550,600,550,550,600,600,550,600,550,600,550,550,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1650,600}; //COLE A LINHA RAW CORRESPONDENTE DENTRO DAS CHAVES
/*
// BOTÃO AVANÇAR CANAIS
unsigned int CMAIS[68] = {}; //COLE A LINHA RAW CORRESPONDENTE DENTRO DAS CHAVES
// BOTÃO ENTRADAS
unsigned int ENTRADAS[68] = {}; //COLE A LINHA RAW CORRESPONDENTE DENTRO DAS CHAVES
// BOTÃO DIMINUIR VOLUME
unsigned int VMENOS[68] = {}; //COLE A LINHA RAW CORRESPONDENTE DENTRO DAS CHAVES
// BOTÃO OK
unsigned int BOTAOOK[68] = {}; //COLE A LINHA RAW CORRESPONDENTE DENTRO DAS CHAVES
// BOTÃO VOLTAR CANAIS
unsigned int CMENOS[68] = {}; //COLE A LINHA RAW CORRESPONDENTE DENTRO DAS CHAVES
*/
 
void setup(){
  irsend.begin(); //INICIALIZA A FUNÇÃO
  Serial.begin(115200); //INICIALIZA A PORTA SERIAL
}
void loop(){
    
    char c = Serial.read(); //VARIÁVEL RESPONSÁVEL POR RECEBER O CARACTER DIGITADO NA JANELA SERIAL
    
    if (c == 'a'){ //SE CARACTER DIGITADO FOR IGUAL A "a", FAZ
        irsend.sendRaw(LD,tamanho,frequencia);  // PARÂMETROS NECESSÁRIOS PARA ENVIO DO SINAL IR
        Serial.println("Comando enviado: Liga / Desliga");
        delay(50); // TEMPO(EM MILISEGUNDOS) DE INTERVALO ENTRE UM COMANDO E OUTRO
    }
    if (c == 'b'){ //SE CARACTER DIGITADO FOR IGUAL A "b", FAZ
        irsend.sendRaw(MT,tamanho,frequencia); // PARÂMETROS NECESSÁRIOS PARA ENVIO DO SINAL IR
        Serial.println("Comando enviado: Mute");
        delay(50); // TEMPO(EM MILISEGUNDOS) DE INTERVALO ENTRE UM COMANDO E OUTRO
    }
    if (c == 'f'){ //SE CARACTER DIGITADO FOR IGUAL A "f", FAZ
        irsend.sendRaw(UM,tamanho,frequencia); // PARÂMETROS NECESSÁRIOS PARA ENVIO DO SINAL IR
        Serial.println("Comando enviado: Um");
        delay(50); // TEMPO(EM MILISEGUNDOS) DE INTERVALO ENTRE UM COMANDO E OUTRO
    }
    if (c == 'g'){ //SE CARACTER DIGITADO FOR IGUAL A "g", FAZ
        irsend.sendRaw(DOIS,tamanho,frequencia); // PARÂMETROS NECESSÁRIOS PARA ENVIO DO SINAL IR
        Serial.println("Comando enviado: Dois");
        delay(50); // TEMPO(EM MILISEGUNDOS) DE INTERVALO ENTRE UM COMANDO E OUTRO
    }
    if (c == 'h'){ //SE CARACTER DIGITADO FOR IGUAL A "h", FAZ
        irsend.sendRaw(TRES,tamanho,frequencia); // PARÂMETROS NECESSÁRIOS PARA ENVIO DO SINAL IR
        Serial.println("Comando enviado: Tres");
        delay(50); // TEMPO(EM MILISEGUNDOS) DE INTERVALO ENTRE UM COMANDO E OUTRO
    }
    if (c == 'p'){ //SE CARACTER DIGITADO FOR IGUAL A "p", FAZ
        irsend.sendRaw(ZERO,tamanho,frequencia); // PARÂMETROS NECESSÁRIOS PARA ENVIO DO SINAL IR
        Serial.println("Comando enviado: Diminuir Volume");
        delay(50); // TEMPO(EM MILISEGUNDOS) DE INTERVALO ENTRE UM COMANDO E OUTRO
    }
}
